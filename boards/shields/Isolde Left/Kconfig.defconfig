## boards/shields/Isolde Left/Kconfig.defconfig
```kconfig
# Copyright (c) 2022 The ZMK Contributors
# SPDX-License-Identifier: MIT

if SHIELD_ISOLDE_LEFT

config ZMK_KEYBOARD_NAME
    default "Isolde_Left"

endif
```

## boards/shields/Kyria_Clone/Kconfig.shield
```kconfig
# Copyright (c) 2020 Pete Johanson
# SPDX-License-Identifier: MIT

config SHIELD_ISOLDE
    bool

config SHIELD_ISODLE_LEFT
    def_bool $(shields_list_contains,isolde_left)
    select SHIELD_ISOLDE

config SHIELD_ISOLDE_RIGHT
    def_bool $(shields_list_contains,isolde_right)
    select SHIELD_ISOLDE
```

## boards/shields/kconfig.defconfig
```kconfig
if SHIELD_ISOLDE_LEFT
config ZMK_KEYBOARD_NAME
    default "isolde"
config ZMK_SPLIT_ROLE_CRITICAL
    default y
endif

if SHIELD_ISOLDE_LEFT || SHIELD_ISOLDE_RIGHT
    config ZMK_SPLIT
        default y 
endif
```
