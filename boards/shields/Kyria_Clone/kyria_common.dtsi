
#include <dt-bindings/zmk/matrix_transform.h>

#include "isolde-layouts.dtsi"

/ {
    chosen {
        zmk,kscan = &kscan0;
        zmk,physical-layout = &splitkb_kyria_6col_layout;
    };

    kscan0: kscan {
        compatible = "zmk,kscan-gpio-matrix";
        wakeup-source;

        diode-direction = "col2row";
    };

};

&pro_micro_i2c {
    status = "okay";
};
